## boards/shields/sweeppp2/Kconfig.defconfig
```kconfig
if SHIELD_SWEEP2PP_LEFT

config ZMK_KEYBOARD_NAME
    default "Sweep2++"

config ZMK_SPLIT_ROLE_CENTRAL
    default y

endif

if SHIELD_SWEEP2PP_LEFT || SHIELD_SWEEP2PP_RIGHT

config ZMK_SPLIT
    default y

endif
```

## boards/shields/sweeppp2/Kconfig.shield
```kconfig
config SHIELD_SWEEPPP2_LEFT
    def_bool $(shields_list_contains,sweeppp2_left)

config SHIELD_SWEEPPP2_RIGHT
    def_bool $(shields_list_contains,sweeppp2_right)
```
