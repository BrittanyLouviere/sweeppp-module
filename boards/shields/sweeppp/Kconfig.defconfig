## boards/shields/sweeppp/Kconfig.defconfig
```kconfig
if SHIELD_SWEEPPP_LEFT

config ZMK_KEYBOARD_NAME
    default "Sweep++"

config ZMK_SPLIT_ROLE_CENTRAL
    default y

endif

if SHIELD_SWEEPPP_LEFT || SHIELD_SWEEPPP_RIGHT

config ZMK_SPLIT
    default y

endif
```

## boards/shields/sweeppp/Kconfig.shield
```kconfig
config SHIELD_SWEEPPP_LEFT
    def_bool $(shields_list_contains,sweeppp_left)

config SHIELD_SWEEPPP_RIGHT
    def_bool $(shields_list_contains,sweeppp_right)
```
